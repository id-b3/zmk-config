## boards/shields/skeletyl/Kconfig.defconfig
```kconfig
# Copyright (c) 2022 ZMK Contributors
# SPDX-License-Identifier: MIT
 

if SHIELD_SKELETYL_LEFT

config ZMK_KEYBOARD_NAME
	default "Skeletyl Left"

endif

if SHIELD_SKELETYL_RIGHT

config ZMK_KEYBOARD_NAME
	default "Skeletyl Right"

config ZMK_SPLIT_ROLE_CENTRAL
	default y

config ZMK_SPLIT_BLE_CENTRAL_BATTERY_LEVEL_FETCHING
	default y

config ZMK_SPLIT_BLE_CENTRAL_BATTERY_LEVEL_PROXY
	default y

endif

if SHIELD_SKELETYL_LEFT || SHIELD_SKELETYL_RIGHT

config ZMK_SPLIT
	default y
	
endif
```

## config/west.yml
```yaml
manifest:
  remotes:
    - name: zmkfirmware
      url-base: https://github.com/zmkfirmware
  projects:
    - name: zmk
      remote: zmkfirmware
      revision: main # Or pin to a specific ZMK version/commit if desired
      import: app/west.yml
  self:
    path: config # Tells west your config repository is in the 'config' directory
```
