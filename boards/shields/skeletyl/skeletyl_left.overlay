// SPDX-License-Identifier: MIT
#include "skeletyl.dtsi" // Include common definitions

// Enable the left encoder defined in the .dtsi file
&left_encoder {
    status = "okay";
};

// Define the column pins for the left half matrix
&kscan0 {
    col-gpios
        = <&gpio0 20 (GPIO_ACTIVE_HIGH | GPIO_PULL_DOWN)>
        , <&gpio0 10 (GPIO_ACTIVE_HIGH | GPIO_PULL_DOWN)>
        , <&gpio0 6  (GPIO_ACTIVE_HIGH | GPIO_PULL_DOWN)>
        , <&gpio0 7  (GPIO_ACTIVE_HIGH | GPIO_PULL_DOWN)>
        , <&gpio0 8  (GPIO_ACTIVE_HIGH | GPIO_PULL_DOWN)>
        ;
};