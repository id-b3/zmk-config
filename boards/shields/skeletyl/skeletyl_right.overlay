// SPDX-License-Identifier: MIT
#include "skeletyl.dtsi" // Include common definitions

// Enable the right encoder defined in the .dtsi file
&right_encoder {
    status = "okay";
};

// Apply column offset for the right half in the matrix transform
&default_transform {
    col-offset = <5>; // Start right half keys at logical column 5
};

// Define the column pins for the right half matrix
&kscan0 {
    col-gpios
        = <&gpio0 8  (GPIO_ACTIVE_HIGH | GPIO_PULL_DOWN)>
        , <&gpio0 7  (GPIO_ACTIVE_HIGH | GPIO_PULL_DOWN)>
        , <&gpio0 6  (GPIO_ACTIVE_HIGH | GPIO_PULL_DOWN)>
        , <&gpio0 10 (GPIO_ACTIVE_HIGH | GPIO_PULL_DOWN)>
        , <&gpio0 20 (GPIO_ACTIVE_HIGH | GPIO_PULL_DOWN)>
        ;
};
